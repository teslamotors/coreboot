## configs/r_defconfig
```kconfig
CONFIG_LOCALVERSION="r"
CONFIG_ANY_TOOLCHAIN=y
# CONFIG_COMPRESS_PRERAM_STAGES is not set
CONFIG_VENDOR_TURBO=y
CONFIG_COREBOOT_ROMSIZE_KB_9216=y
CONFIG_JUMP_TO_KERNEL=y
CONFIG_TRAV_UFS=y
CONFIG_TRAV_UFS_CONFIGURE_DEVICE_LUN=y
CONFIG_DEFAULT_CONSOLE_LOGLEVEL_3=y
CONFIG_PAYLOAD_NONE=y
```

## configs/x_defconfig
```kconfig
CONFIG_LOCALVERSION="x"
# CONFIG_COMPRESS_PRERAM_STAGES is not set
CONFIG_ANY_TOOLCHAIN=y
CONFIG_VENDOR_TURBO=y
CONFIG_COREBOOT_ROMSIZE_KB_12288=y
CONFIG_BOOTBLOCK_X=y
CONFIG_JUMP_TO_KERNEL=y
CONFIG_TRAV_UFS=y
# CONFIG_USE_BLK_TRIP0 is not set
# CONFIG_USE_BLK_TRIP1 is not set
CONFIG_DEFAULT_CONSOLE_LOGLEVEL_3=y
CONFIG_PAYLOAD_NONE=y
```

## src/drivers/amd/dgpu/Kconfig
```kconfig
config HAVE_AMD_DGPU
	bool
	default n
	help
	  Activate if your platform has an AMD discrete graphics card.

config AMD_DGPU_ATPX
	bool
	depends on HAVE_AMD_DGPU
	help
	  Select this option to provide ATPX methods via ACPI.  This is used
	  to advertise hybrid graphics support to the OS.

config AMD_DGPU_BOCO_SUPPORT
	bool
	select AMD_DGPU_ATPX
	help
	  Select this option to advertise to the OS that the mainboard is
	  equipped with a BOCO-capable dGPU.  BOCO (Bus off, Chip off) support
	  usually requires GPIO control for dGPU power enable inputs.
```

## src/drivers/amd/ftpm/Kconfig
```kconfig
config HAVE_AMD_FTPM
	bool
	default n
	depends on SOC_AMD_COMMON
	select MAINBOARD_HAS_CRB_TPM
	select CRB_TPM_BUFFER_ALLOC
	select CRB_TPM_ACPI_START_METHOD
	select SOC_AMD_COMMON_BLOCK_PSP_SMI
	help
	  Activate if your platform has an AMD PSP fTPM and you want to use it.
```

## src/drivers/crb/Kconfig
```kconfig
config CRB_TPM
	bool
	help
	  CRB TPM driver is enabled!

config CRB_TPM_BASE_ADDRESS
	hex
	default 0xfed40000
	help
	  Base Address of the CRB TPM Command Structure

config MAINBOARD_HAS_CRB_TPM
	bool
	default n
	select CRB_TPM
	help
	  Mainboard has Command Response Buffer support

config CRB_TPM_BUFFER_ALLOC
	bool
	default n
	help
	  Allocate and reserve memory for the CRB command/response buffer

config CRB_TPM_BUFFER_SIZE
	hex
	default 0x8000
	help
	  Allocation size for the CRB command/response buffer

config CRB_TPM_ACPI_START_METHOD
	bool
	default n
	help
	  Use TPM2 ACPI Start Method

config CRB_USE_CUSTOM_OEM_ID
	bool
	default n
	help
	  Use a Custom OEM ID in the ACPI device header.

config CRB_CUSTOM_OEM_ID
	string
	default "OEM_ID"
	help
	  The custom OEM ID string to populate the TPM2 ACPI header with.
	  OEM_ID must be 6 characters long per the spec of the RSDP structure.
```

## src/drivers/qualcomm/Kconfig
```kconfig
config DRIVERS_QUALCOMM
	bool "Support Qualcomm WiFi/BT Moodule"
	default n
	help
	  When enabled, add identifiers in ACPI tables for Qualcomm WiFi/BT.
```

## src/drivers/tpm/Kconfig
```kconfig
config TPM_INIT
	bool
	default y if TPM1 || TPM2
	depends on !VBOOT || VBOOT_MOCK_TPM
	help
	  This driver automatically initializes the TPM if vboot is
	  not used, or it mocks the TPM hooks and skips initialization.
	  The TPM driver init is done during the ramstage chip init phase.
```

## src/mainboard/tesla/Kconfig
```kconfig
## SPDX-License-Identifier: GPL-2.0-only

if VENDOR_TESLA

choice
	prompt "Mainboard model"

source "src/mainboard/tesla/*/Kconfig.name"

endchoice

source "src/mainboard/tesla/*/Kconfig"

config MAINBOARD_VENDOR
	default "Tesla"

endif # VENDOR_TESLA
```

## src/mainboard/tesla/infoz/Kconfig
```kconfig
# SPDX-License-Identifier: GPL-2.0-or-later

config BOARD_TESLA_INFOZ
	def_bool n

if BOARD_TESLA_INFOZ

config BOARD_SPECIFIC_OPTIONS
	def_bool y
	select SOC_AMD_PICASSO
	select SOC_AMD_COMMON_BLOCK_GRAPHICS_ATIF
	select VGA_BIOS
	select BOARD_ROMSIZE_KB_16384
	select CONSOLE_OVERRIDE_LOGLEVEL
	select DISABLE_SPI_FLASH_ROM_SHARING
	select DRIVERS_I2C_GENERIC
	select DRIVERS_I2C_HID
	select DRIVERS_I2C_MP2
	select HAVE_ACPI_TABLES
	select GFXUMA
	select TESLA_SMBIOS_MAINBOARD_VERSION
	select MAINBOARD_HAS_CHROMEOS
	select PICASSO_CONSOLE_UART
	select MAINBOARD_HAS_TPM2
	select HAVE_AMD_FTPM
	select HAVE_AMD_DGPU
	select AMD_DGPU_BOCO_SUPPORT
	select SOC_AMD_DISABLE_SERIRQ
	select PCIEXP_ASPM
	select PCIEXP_CLK_PM
	select PCIEXP_COMMON_CLOCK
	select HAVE_EM100_SUPPORT
	select SYSTEM_TYPE_LAPTOP
	select HAVE_ACPI_RESUME
	select DRIVERS_USB_ACPI
	select PSP_LOAD_MP2_FW
	select PSP_PLATFORM_SECURE_BOOT
	select AMD_FW_UNCOMPRESSED_BIOS_BIN
	select SPI_FLASH_DONT_INCLUDE_ALL_DRIVERS
	select SPI_FLASH_STMICRO
	select SOC_AMD_COMMON_BLOCK_SPI_ALT
	select SOC_AMD_BIOSRAM_PANIC_MSG

config FMDFILE
	string
	default "src/mainboard/\$(CONFIG_MAINBOARD_DIR)/tesla_infoz.fmd"

config MAINBOARD_DIR
	string
	default "tesla/infoz"

config VARIANT_DIR
	string
	default "coriander" if BOARD_TESLA_CORIANDER

config MAINBOARD_PART_NUMBER
	string
	default "Coriander" if BOARD_TESLA_CORIANDER

config DEVICETREE
	string
	default "devicetree.cb"

config OVERRIDE_DEVICETREE
	string
	default "variants/\$(CONFIG_VARIANT_DIR)/overridetree.cb"

config MAINBOARD_FAMILY
	string
	default "Tesla_InfoZ"

config MAX_CPUS
	int
	default 8

config ONBOARD_VGA_IS_PRIMARY
	bool
	default y

config VGA_BIOS_FILE
	string
	default "3rdparty/amd_blobs/picasso/PicassoFremontVbios.bin"

# Boards with V1807B can't use the Picasso VBIOS
config VGA_BIOS_SECOND_ID
        string
        default "1002,15dd,81"

config VGA_BIOS_SECOND_FILE
        string
        default "3rdparty/amd_blobs/picasso/RavenGenericVbios.bin"

config CRB_TPM_BASE_ADDRESS
	hex
	default 0xfd1104d0
	help
	  Base Address of the CRB TPM Command Structure

config VBOOT
	select VBOOT_STARTS_IN_BOOTBLOCK
	select VBOOT_NO_BOARD_SUPPORT
	select VBOOT_SLOTS_RW_A
	select VBOOT_MOCK_SECDATA
	select VBOOT_MOCK_TPM
	select VBOOT_VERIFY_RO
	select VBOOT_REFUSE_RECOVERY
	select VBOOT_ALWAYS_ENABLE_DISPLAY
	select VBOOT_DISABLE_SHA1

config VBOOT_FWID_VERSION
	string
	default "infoz"

config VBOOT_VBNV_OFFSET
	hex
	default 0x2A

config CHROMEOS
	# Use default libpayload config
	select LP_DEFCONFIG_OVERRIDE if PAYLOAD_DEPTHCHARGE

config AMD_FWM_POSITION_INDEX
	int
	default 5	# 0x20000

config AMD_PUBKEY_FILE
	string
	default "3rdparty/amd_blobs/picasso/PSP/tesla/infoz/AmdPubKeyRV.bin"

config PSP_BOOTLOADER_FILE
	string
	default "3rdparty/amd_blobs/picasso/PSP/tesla/infoz/PspBootLoader_prod_RV.sbin"

config DRIVER_TPM_I2C_BUS
	hex
	default 0x03

config DRIVER_TPM_I2C_ADDR
	hex
	default 0x50

config USE_OEM_BIN
	bool "Add an oem.bin file"
	help
	  Add an oem.bin file to identify the manufacturer in SMBIOS, overriding the
	  CONFIG_MAINBOARD_SMBIOS_MANUFACTURER value.

config OEM_BIN_FILE
	string "OEM ID table"
	depends on USE_OEM_BIN
	default ""

config VARIANT_HAS_FW_CONFIG
	bool
	help
	  Honor FW_CONFIG in CBI.

config VARIANT_BOARD_VER_FW_CONFIG_VALID
	int
	default 256
	depends on VARIANT_HAS_FW_CONFIG
	help
	  Which board version did FW_CONFIG become valid in CBI.

config EFS_SPI_READ_MODE
       int
       default 0 if EM100	# Normal read mode
       default 5		# Quad IO (1-4-4)

config EFS_SPI_SPEED
       int
       default 3 if EM100	# 16.66 MHz
       default 0		# 66.66 MHz

config EFS_SPI_MICRON_FLAG
       int
       default 1		# Board always uses Micron parts

config SPI_FLASH_STMICRO_SE32K
       bool
       default n

config SPI_FLASH_STMICRO_SE64K
       bool
       default n

config SPI_FLASH_STMICRO_SE256K
       bool
       default n

config RW_REGION_ONLY
        string
        depends on VBOOT
        default "fallback/romstage cpu_microcode_blob.bin fallback/ramstage config revision fallback/dsdt.aml fspm.bin fsps.bin pci1002,15d8,c1.rom pci1002,15dd,81.rom fallback/payload bootsplash.jpg"

# dGPU-related nodes require more space than provided by default
config MAX_ACPI_TABLE_SIZE_KB
        int
        default 176

endif # BOARD_TESLA_INFOZ
```

## src/mainboard/tesla/infoz/Kconfig.name
```kconfig
comment "InfoZ"

config BOARD_TESLA_CORIANDER
	bool "->  Coriander"
	select BOARD_TESLA_INFOZ

config BOARD_TESLA_KINGBIRD
	bool "->  Kingbird"
	select BOARD_TESLA_INFOZ

config BOARD_TESLA_SEMI
	bool "->  Semi"
	select BOARD_TESLA_INFOZ

config BOARD_TESLA_SPINACH
	bool "->  Spinach"
	select BOARD_TESLA_INFOZ
```

## src/mainboard/turbo/Kconfig
```kconfig
if VENDOR_TURBO

choice
	prompt "Mainboard model"

source "src/mainboard/turbo/*/Kconfig.name"

endchoice

source "src/mainboard/turbo/*/Kconfig"

config MAINBOARD_VENDOR
	string
	default "TURBO"

endif # VENDOR_TURBO
```

## src/mainboard/turbo/sentinel/Kconfig
```kconfig
##
## This file is part of the coreboot project.
##
## Copyright 2017 Samsung Electronics Ltd.
##
## This program is free software; you can redistribute it and/or modify
## it under the terms of the GNU General Public License as published by
## the Free Software Foundation; version 2 of the License.
##
## This program is distributed in the hope that it will be useful,
## but WITHOUT ANY WARRANTY; without even the implied warranty of
## MERCHANTABILITY or FITNESS FOR A PARTICULAR PURPOSE.  See the
## GNU General Public License for more details.
##
## You should have received a copy of the GNU General Public License
## along with this program; if not, write to the Free Software
## Foundation, Inc., 51 Franklin St, Fifth Floor, Boston, MA 02110-1301 USA
##

if BOARD_TURBO_SENTINEL

config BOARD_SPECIFIC_OPTIONS
	def_bool y
	select ARCH_AARCH64
	select SOC_TURBO_TRAV
	select HAVE_UART_MEMORY_MAPPED
	select BOARD_ROMSIZE_KB_4096

config MAINBOARD_DIR
	string
	default turbo/sentinel

config MAINBOARD_VENDOR
	string
	default "TURBO"

config MAINBOARD_PART_NUMBER
	string
	default "Sentinel"

config DRAM_SIZE_MB
	int
	default 2048

endif # BOARD_TURBO_SENTINEL
```

## src/soc/amd/common/block/acpimmio/Kconfig
```kconfig
config SOC_AMD_COMMON_BLOCK_ACPIMMIO
	bool
	default n
	help
	  Select this option to enable hardware blocks in the AcpiMmio
	  address space (0xfed8xxxx).

config SOC_AMD_BIOSRAM_PANIC_MSG
	bool
	default n
	help
	  Select this option to enable support to detect kernel panic
	  messages stored in the BIOSRAM region.  Requires OS support
	  to be useful.
```

## src/soc/amd/common/block/lpc/Kconfig
```kconfig
config SOC_AMD_COMMON_BLOCK_LPC
	bool
	default n
	help
	  Select this option to use the traditional LPC-ISA bridge at D14F3.

config PROVIDES_ROM_SHARING
	bool
	default n
	help
	  Select this option if the LPC bridge supports ROM sharing.

config SOC_AMD_COMMON_BLOCK_HAS_ESPI
	bool
	default n
	help
	  Select this option if platform supports eSPI using D14F3 configuration
	  registers.

config SOC_AMD_DISABLE_SERIRQ
	bool
	default n
	help
	  Select this option to disable serial IRQ functionality on the
	  LPC interface.

config SOC_AMD_COMMON_BLOCK_USE_ESPI
	bool
	depends on SOC_AMD_COMMON_BLOCK_HAS_ESPI
	select SOC_AMD_DISABLE_SERIRQ
	default n
	help
	  Select this option if mainboard uses eSPI instead of LPC (if supported
	  by platform).
```
